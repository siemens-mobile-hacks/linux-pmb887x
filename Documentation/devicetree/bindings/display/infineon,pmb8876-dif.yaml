## Documentation/devicetree/bindings/display/infineon,pmb8876-dif.yaml
```yaml
# SPDX-License-Identifier: (GPL-2.0-only OR BSD-2-Clause)
%YAML 1.2
---
$id: http://devicetree.org/schemas/display/infineon,pmb8876-dif.yaml#
$schema: http://devicetree.org/meta-schemas/core.yaml#

title: Infineon PMB8876 DIFv2 Display Interface

maintainers:
  - Alula <git@alula.me>

description: |
  The Display Interface (DIF) v2 of the Infineon PMB8876 (S-Gold2) is an
  MCU-parallel (Intel 8080 style) display interface. It drives an 8-bit data
  bus with a command/data strobe (CD), a write strobe, an optional read strobe
  and up to two chip selects, so several displays can share the bus. Each write
  to the transmit FIFO latches its own chip select and CD state, which allows a
  command and its pixel data to be queued back to back.

  In front of the bus sits a 32x32 bit multiplexer with per-bit constant,
  clamping and inversion stages plus a 3x3 colour matrix, so pixel data can be
  re-packed and converted on the fly. Both FIFOs can be served by the SoC's
  PL080 DMA controller.

  The PL080 slave channels are not described here. On this SoC the DMA
  controller is instantiated from platform data and its slave channels are
  matched by device name, so the DIF transmit and receive channels are resolved
  through the machine code rather than through a dmas phandle.

properties:
  compatible:
    const: infineon,pmb8876-dif

  reg:
    maxItems: 1

  interrupts:
    maxItems: 4

  interrupt-names:
    items:
      - const: rx-single
      - const: rx-burst
      - const: tx
      - const: err

  clocks:
    maxItems: 1

  "#address-cells":
    const: 1

  "#size-cells":
    const: 0

patternProperties:
  "^panel@[1-2]$":
    $ref: panel/renesas,r61505u.yaml#
    description:
      A display attached to one of the two chip selects of the interface.

required:
  - compatible
  - reg
  - interrupts
  - interrupt-names
  - clocks
  - "#address-cells"
  - "#size-cells"

additionalProperties: false

examples:
  - |
    #include <dt-bindings/gpio/gpio.h>

    display-controller@f7100000 {
        compatible = "infineon,pmb8876-dif";
        reg = <0xf7100000 0xc004>;
        interrupts = <134>, <135>, <136>, <137>;
        interrupt-names = "rx-single", "rx-burst", "tx", "err";
        clocks = <&clc 7>;
        pinctrl-names = "default";
        pinctrl-0 = <&dif_pads>;
        #address-cells = <1>;
        #size-cells = <0>;

        panel@1 {
            compatible = "renesas,r61505u";
            reg = <1>;
            reset-gpios = <&gpio 27 GPIO_ACTIVE_LOW>;
            backlight = <&backlight>;
            rotation = <0>;
            write-only;
            infineon,init-sequence = [
                01 02 02 00 07 00 00
                02 0a
                01 02 02 00 07 01 73
            ];
        };
    };
...
```

## Documentation/devicetree/bindings/display/panel/renesas,r61505u.yaml
```yaml
# SPDX-License-Identifier: (GPL-2.0-only OR BSD-2-Clause)
%YAML 1.2
---
$id: http://devicetree.org/schemas/display/panel/renesas,r61505u.yaml#
$schema: http://devicetree.org/meta-schemas/core.yaml#

title: Renesas R61505U based MCU-parallel Display Panel

maintainers:
  - Alula <git@alula.me>

description:
  The Renesas R61505U is an ILI9320-class controller for 240x320 TFT panels.
  It is driven over an MCU-parallel (Intel 8080 style) bus, where a register is
  selected by a 16-bit index written with the command/data line asserted and
  the 16-bit register value follows with that line deasserted.

allOf:
  - $ref: panel-common.yaml#

properties:
  compatible:
    const: renesas,r61505u

  reg:
    description: Index of the chip select the panel is wired to.
    minimum: 1
    maximum: 2

  write-only:
    type: boolean
    description:
      The read strobe of the panel is not wired up, so the controller can
      never be read back. Panel identification and the current register
      contents are then unknowable and the driver must rely on the init
      sequence alone.

  infineon,continuous-splash:
    type: boolean
    description:
      The boot loader has already brought the panel up and left an image on
      screen. Reset, the init sequence and the initial GRAM clear are skipped
      so that the image survives until the first frame is flushed.

  infineon,init-sequence:
    $ref: /schemas/types.yaml#/definitions/uint8-array
    description: |
      Controller bring-up program, run once after reset. It is a flat stream of
      variable length commands, each introduced by an opcode byte:

        0x01 <ncmd> <nparam> <cmd bytes> <param bytes>
          Send ncmd bytes with the command/data line asserted, followed by
          nparam bytes with it deasserted.

        0x02 <ms>
          Wait ms milliseconds.

      A register write on this panel is therefore
      01 02 02 00 <index> <value hi> <value lo>: the register index goes out
      as the two command bytes 0x00 and <index>, and the 16-bit value follows
      as two data bytes, most significant byte first.

  backlight: true
  reset-gpios: true
  rotation: true
  te-gpios: true

required:
  - compatible
  - reg

additionalProperties: false

examples:
  - |
    #include <dt-bindings/gpio/gpio.h>

    display-controller {
        #address-cells = <1>;
        #size-cells = <0>;

        panel@1 {
            compatible = "renesas,r61505u";
            reg = <1>;
            reset-gpios = <&gpio 27 GPIO_ACTIVE_LOW>;
            backlight = <&backlight>;
            rotation = <0>;
            write-only;
            infineon,init-sequence = [
                01 02 02 00 07 00 00
                02 0a
                01 02 02 00 07 01 73
            ];
        };
    };
...
```

## Documentation/devicetree/bindings/input/infineon,pmb8876-keypad.yaml
```yaml
# SPDX-License-Identifier: (GPL-2.0-only OR BSD-2-Clause)
%YAML 1.2
---
$id: http://devicetree.org/schemas/input/infineon,pmb8876-keypad.yaml#
$schema: http://devicetree.org/meta-schemas/core.yaml#

title: Infineon PMB8876 Keypad Scanner

maintainers:
  - Alula <git@alula.me>

description: |
  The keypad block of the Infineon PMB8876 (S-Gold2) scans a matrix of up to
  eight input rows by twelve output columns without software help and latches
  the result into three PORT registers, each holding four columns of eight
  active low rows.

  It raises four service requests: a key was pressed, the hardware repeat
  interval elapsed, an internal condition, and a key was released. Only the
  press and release requests are used by Linux, which does its own autorepeat,
  but all four are described here because all four are wired to the interrupt
  controller. The requests only serve to wake the driver out of idle; the
  matrix is polled for as long as a key is held, because the release request
  can arrive before the PORT registers reflect the release.

  The SoC brings out four column lines on dedicated pads. A board may drive
  further columns from a pad whose alternate output function is a keypad
  column, in which case those columns appear in the second and third PORT
  register and only the pin control setup differs.

allOf:
  - $ref: /schemas/input/matrix-keymap.yaml#

properties:
  compatible:
    const: infineon,pmb8876-keypad

  reg:
    maxItems: 1

  interrupts:
    maxItems: 4

  interrupt-names:
    items:
      - const: press
      - const: repeat
      - const: int2
      - const: release

  linux,no-autorepeat:
    type: boolean
    description:
      Do not enable autorepeat in the input core for this keypad.

  poll-interval:
    default: 20
    description:
      Interval in milliseconds at which the matrix is re-read while a key is
      held down.

required:
  - compatible
  - reg
  - interrupts
  - interrupt-names
  - linux,keymap
  - keypad,num-rows
  - keypad,num-columns

unevaluatedProperties: false

examples:
  - |
    #include <dt-bindings/input/input.h>

    keypad@f4d00000 {
        compatible = "infineon,pmb8876-keypad";
        reg = <0xf4d00000 0x200>;
        interrupts = <108>, <109>, <110>, <111>;
        interrupt-names = "press", "repeat", "int2", "release";
        pinctrl-names = "default";
        pinctrl-0 = <&kp_pads>;

        keypad,num-rows = <2>;
        keypad,num-columns = <2>;

        linux,keymap = <MATRIX_KEY(0, 0, KEY_MENU)
                        MATRIX_KEY(0, 1, KEY_ENTER)
                        MATRIX_KEY(1, 0, KEY_1)
                        MATRIX_KEY(1, 1, KEY_2)>;
    };
...
```

## arch/arm/configs/pmb8876_xip_defconfig
```kconfig
# CONFIG_LOCALVERSION_AUTO is not set
CONFIG_KERNEL_XZ=y
CONFIG_NO_HZ_IDLE=y
CONFIG_HIGH_RES_TIMERS=y
CONFIG_EXPERT=y
CONFIG_BASE_SMALL=y
CONFIG_PERF_EVENTS=y
# CONFIG_ARM_PATCH_PHYS_VIRT is not set
CONFIG_PHYS_OFFSET=0xb0000000
# CONFIG_ARCH_MULTIPLATFORM is not set
# CONFIG_ARCH_MULTI_V7 is not set
CONFIG_ARCH_PMB887X=y
CONFIG_MACH_PMB887X=y
# CONFIG_ATAGS is not set
CONFIG_XIP_KERNEL=y
CONFIG_XIP_PHYS_ADDR=0xa0100000
CONFIG_CPU_FREQ=y
CONFIG_CPU_FREQ_DEFAULT_GOV_ONDEMAND=y
CONFIG_CPU_IDLE=y
CONFIG_CPU_IDLE_GOV_LADDER=y
CONFIG_CPU_IDLE_GOV_TEO=y
CONFIG_ARM_CPUIDLE=y
CONFIG_VFP=y
# CONFIG_SUSPEND is not set
# CONFIG_SECCOMP is not set
# CONFIG_STACKPROTECTOR is not set
CONFIG_ARCH_MMAP_RND_BITS=16
CONFIG_PARTITION_ADVANCED=y
CONFIG_ZSWAP=y
CONFIG_ZSWAP_DEFAULT_ON=y
CONFIG_ZSWAP_SHRINKER_DEFAULT_ON=y
CONFIG_SLUB_TINY=y
# CONFIG_COMPAT_BRK is not set
CONFIG_KSM=y
# CONFIG_VM_EVENT_COUNTERS is not set
CONFIG_NET=y
CONFIG_PACKET=y
CONFIG_UNIX=y
CONFIG_TLS=y
CONFIG_INET=y
# CONFIG_IPV6 is not set
# CONFIG_WIRELESS is not set
# CONFIG_ETHTOOL_NETLINK is not set
CONFIG_DEVTMPFS=y
CONFIG_DEVTMPFS_MOUNT=y
CONFIG_DEVTMPFS_SAFE=y
# CONFIG_STANDALONE is not set
# CONFIG_PREVENT_FIRMWARE_BUILD is not set
CONFIG_MTD=y
CONFIG_NETDEVICES=y
# CONFIG_ETHERNET is not set
# CONFIG_WLAN is not set
CONFIG_INPUT_FF_MEMLESS=y
# CONFIG_KEYBOARD_ATKBD is not set
# CONFIG_INPUT_MOUSE is not set
CONFIG_SERIO_LIBPS2=y
CONFIG_LEGACY_PTY_COUNT=16
# CONFIG_LDISC_AUTOLOAD is not set
CONFIG_SERIAL_PMB887X=y
CONFIG_SERIAL_PMB887X_CONSOLE=y
# CONFIG_HW_RANDOM is not set
# CONFIG_DEVMEM is not set
# CONFIG_DEVPORT is not set
CONFIG_POWER_SUPPLY=y
# CONFIG_HWMON is not set
CONFIG_THERMAL=y
CONFIG_THERMAL_NETLINK=y
CONFIG_WATCHDOG=y
CONFIG_MFD_SYSCON=y
CONFIG_REGULATOR=y
CONFIG_REGULATOR_DEBUG=y
CONFIG_REGULATOR_FIXED_VOLTAGE=y
CONFIG_FB=y
CONFIG_FRAMEBUFFER_CONSOLE=y
# CONFIG_HID_SUPPORT is not set
# CONFIG_USB_SUPPORT is not set
CONFIG_MMC=y
CONFIG_MMC_DEBUG=y
CONFIG_MMC_CQHCI=y
CONFIG_MMC_HSQ=y
CONFIG_NEW_LEDS=y
CONFIG_LEDS_CLASS=y
CONFIG_LEDS_TRIGGERS=y
CONFIG_DMADEVICES=y
# CONFIG_VIRTIO_MENU is not set
# CONFIG_VHOST_MENU is not set
# CONFIG_IOMMU_SUPPORT is not set
# CONFIG_NVMEM is not set
CONFIG_EXT2_FS=y
CONFIG_EXT2_FS_XATTR=y
CONFIG_AUTOFS_FS=y
CONFIG_VFAT_FS=y
CONFIG_TMPFS=y
CONFIG_TMPFS_POSIX_ACL=y
CONFIG_CONFIGFS_FS=y
# CONFIG_MISC_FILESYSTEMS is not set
CONFIG_CRYPTO_CRC32C=y
CONFIG_FONTS=y
CONFIG_FONT_8x8=y
CONFIG_FONT_6x8=y
CONFIG_PRINTK_TIME=y
CONFIG_CONSOLE_LOGLEVEL_DEFAULT=15
CONFIG_CONSOLE_LOGLEVEL_QUIET=15
CONFIG_MESSAGE_LOGLEVEL_DEFAULT=7
# CONFIG_SYMBOLIC_ERRNAME is not set
# CONFIG_SECTION_MISMATCH_WARN_ONLY is not set
CONFIG_MAGIC_SYSRQ=y
CONFIG_DEBUG_FS=y
CONFIG_UNWINDER_FRAME_POINTER=y
# CONFIG_RUNTIME_TESTING_MENU is not set
```

## arch/arm/mach-pmb887x/Kconfig
```kconfig
# SPDX-License-Identifier: GPL-2.0-only
menuconfig ARCH_PMB887X
	bool "Infineon PMB887x SoCs"
	depends on ARCH_MULTI_V5
	depends on CPU_LITTLE_ENDIAN
	select ARM_AMBA
	select HAVE_TCM
	select PMB887X_TPU
	select PMB887X_STM
	select PINCTRL
	select PINCTRL_PMB887X

if ARCH_PMB887X

config MACH_PMB887X
	bool "Infineon PMB887X family"
	help
	  Select this if you are using an Infineon PMB887X
	  families.

endif
```

## drivers/gpu/drm/pmb887x/Kconfig
```kconfig
# SPDX-License-Identifier: GPL-2.0-only

config DRM_PMB887X_DIF
	tristate "DRM support for the Infineon PMB8876 display interface"
	depends on DRM && (ARCH_PMB887X || COMPILE_TEST)
	select DRM_CLIENT_SELECTION
	select DRM_KMS_HELPER
	select DRM_GEM_DMA_HELPER
	select BACKLIGHT_CLASS_DEVICE
	help
	  DRM driver for the DIFv2 display interface of the Infineon S-Gold2/S-Gold3
	  phone SoC, driving an MCU-parallel (Intel 8080 style) LCD.

	  If M is selected the module will be called pmb887x-dif.

config DRM_PMB887X_PANEL_ILI9320
	bool "ILI9320 family panels"
	depends on DRM_PMB887X_DIF
	default y
	help
	  Support for panels whose controller addresses its frame memory
	  through a register index and one 16-bit value per coordinate, with
	  rotation expressed as the AM and ID bits of an entry mode register.

	  This covers the R61505U/ILI9320 and its relatives. Say Y unless you
	  know the panel on your board is driven some other way.
```
